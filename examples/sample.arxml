AUTOSAR XML (schema 4-0-3)
standard types defined: uint32
package /ComponentTypes
  application software component type ExampleSWC
    provide port PPort1: provided-interface=ExampleInterface
package /Parameters
  parameter definition ExampleParam: default-value=100
package /Interfaces
  sender receiver interface ExampleInterface
    data Data1: type=uint32
