AUTOSAR XML (schema 4-3-0)
package /ComponentTypes/ApplicationComponents
  application sw component type MyComponent
    behavior MyComponent_InternalBehavior
  swc implementation MyComponent_Implementation: behavior=MyComponent_InternalBehavior
