AUTOSAR XML (schema 4-3-0)
package /ComponentTypes/ApplicationComponents
  application software component type ExampleComponent
package /DataTypes
  integer type Integer32: lower-limit=-2147483648, upper-limit=2147483647
package /System
  system TestSystem
